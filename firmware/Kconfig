## firmware/Kconfig
```kconfig
# deepspan firmware Kconfig top-level entry point
menu "Deepspan Firmware"

config DEEPSPAN_FIRMWARE
    bool "Enable Deepspan Firmware Library"
    select CPP
    select REQUIRES_FULL_LIBCPP
    help
      Enables the Deepspan firmware library.
      Includes ETL, CIB, and VirtioTransport components.
      Set CONFIG_STD_CPP20=y (or higher) in prj.conf.

if DEEPSPAN_FIRMWARE

config DEEPSPAN_USE_ETL
    bool "Use Embedded Template Library (ETL)"
    default y
    depends on DEEPSPAN_FIRMWARE
    help
      Use the ETL library. (etl::fsm, etl::pool, etl::queue, etc.)

config DEEPSPAN_USE_CIB
    bool "Use compile-time-init-build (CIB)"
    default y
    depends on DEEPSPAN_FIRMWARE
    help
      Use the Intel CIB library. (cib::nexus, flow::service, etc.)
      Requires CONFIG_STD_CPP20=y or higher in prj.conf.

config DEEPSPAN_TRANSPORT_SIM
    bool "Simulation transport (POSIX shm + eventfd)"
    default y if BOARD_NATIVE_SIM
    help
      Use simulation transport for the native_sim target.

config DEEPSPAN_TRANSPORT_VIRTIO
    bool "VirtIO/RPMsg transport (real hardware)"
    default y if !BOARD_NATIVE_SIM
    select VIRTIO
    select RPMSG
    select OPENAMP
    help
      Use virtio/RPMsg transport for real hardware.

config DEEPSPAN_RPMSG_CTRL_CHANNEL
    string "RPMsg control channel name"
    default "rpmsg-ctrl"
    depends on DEEPSPAN_TRANSPORT_VIRTIO

config DEEPSPAN_RPMSG_CONFIG_CHANNEL
    string "RPMsg config channel name"
    default "rpmsg-config"
    depends on DEEPSPAN_TRANSPORT_VIRTIO

config DEEPSPAN_PROXY_CONSOLE
    bool "Enable OpenAMP proxy console (PTY)"
    default y
    depends on DEEPSPAN_TRANSPORT_VIRTIO
    select OPENAMP_PROXY

config DEEPSPAN_LOG_LEVEL
    int "Deepspan log level"
    default 3
    range 0 4

endif # DEEPSPAN_FIRMWARE
endmenu
```

## firmware/drivers/deepspan/Kconfig
```kconfig
config DEEPSPAN_HWIP_DRIVER
    bool "Deepspan HWIP driver (production MMIO)"
    depends on DEEPSPAN_FIRMWARE
    help
      Enables the Deepspan HWIP Zephyr driver for real hardware.
      Uses the DTS reg address for MMIO register access.

config DEEPSPAN_HWIP_DRIVER_SIM
    bool "Deepspan HWIP driver (native_sim via POSIX shm)"
    depends on DEEPSPAN_FIRMWARE && BOARD_NATIVE_SIM
    default y if BOARD_NATIVE_SIM
    help
      native_sim variant of the HWIP driver.
      Opens the hw-model POSIX shared memory and mmaps the RegMap region.
      Completion is detected by a polling thread watching IRQ_STATUS.

config DEEPSPAN_HWIP_SIM_SHM_NAME
    string "hw-model POSIX shm name (without leading /)"
    depends on DEEPSPAN_HWIP_DRIVER_SIM
    default "deepspan-sim"
    help
      Name of the POSIX shared memory segment created by hw-model.
      Override at runtime by setting the DEEPSPAN_SHM_NAME environment variable.
```

## firmware/tests/test_fsm/testcase.yaml
```yaml
tests:
  firmware.etl.fsm.basic:
    platform_allow:
      - native_sim/native/64
    tags:
      - etl
      - fsm
    timeout: 60
```

## hwip/accel/firmware/drivers/deepspan_accel/Kconfig
```kconfig
config DEEPSPAN_ACCEL_HWIP
	bool "Deepspan acceleration HWIP driver"
	depends on DEEPSPAN_HWIP_BASE
	help
	  Enable the deepspan acceleration HWIP driver.
	  Provides ECHO, PROCESS, and STATUS command support via
	  the standard deepspan register map interface.
```

## hwip/codec/firmware/drivers/deepspan_codec/Kconfig
```kconfig
config DEEPSPAN_CODEC_HWIP
	bool "Deepspan codec HWIP driver"
	depends on DEEPSPAN_HWIP_BASE
	help
	  Enable the deepspan codec HWIP driver.
	  Provides ENCODE and DECODE command support.
	  This is a skeleton — implement deepspan_codec_hwip.c to complete.
```

## kernel/drivers/deepspan/Kconfig
```kconfig
config DEEPSPAN
    tristate "Deepspan HWIP driver"
    depends on VIRTIO
    select VIRTIO_RING
    help
      Deepspan HWIP Linux kernel driver.
      virtio + io_uring based async multi-device support.

if DEEPSPAN

config DEEPSPAN_TRANSPORT_SIM
    bool "Simulation transport (memfd + eventfd)"
    default n
    help
      Transport for simulation environment. Communicates with native_sim + hw-model.

config DEEPSPAN_TRANSPORT_HW
    bool "Hardware transport (remoteproc + mailbox)"
    default y
    depends on REMOTEPROC
    help
      Transport for actual hardware.

config DEEPSPAN_CRC32_SHASH
    bool "CRC32 hardware shash bridge (Linux Crypto API)"
    depends on DEEPSPAN
    select CRYPTO_HASH
    help
      Register the Deepspan CRC32 hardware engine as a synchronous hash
      (shash) algorithm named "crc32-deepspan" with the Linux Crypto API.

      Once registered, existing userspace applications can use the FPGA
      CRC32 engine via the AF_ALG socket interface (no source changes):

        bind(fd, {AF_ALG, "hash", "crc32-deepspan"});

      Priority 200 — preferred over the generic software CRC32 (100).
      Follows the same pattern as STM32 (stm32-crc32) and Intel SSE4.2
      (crc32c-intel) hardware drivers in the upstream kernel.

      If unsure, say Y.

config DEEPSPAN_KUNIT_TEST
    bool "KUnit tests"
    depends on KUNIT
    help
      Build KUnit-based unit tests.

endif
```

## west.yml
```yaml
manifest:
  version: "1.2"

  remotes:
    - name: zephyrproject
      url-base: https://github.com/zephyrproject-rtos
    - name: myorg
      url-base: https://github.com/myorg
    - name: github
      url-base: https://github.com

  defaults:
    remote: myorg

  projects:
    - name: zephyr
      remote: zephyrproject
      revision: v4.3.0
      import:
        file: west.yml
        name-allowlist:
          - zcbor
          - mbedtls
          - cmsis
          - hal_stm32
          - openamp
          - picolibc

    - name: etl
      remote: github
      repo-path: ETLCPP/etl
      revision: 20.39.4
      path: modules/lib/etl
      groups:
        - firmware

    - name: cib
      remote: github
      repo-path: intel/compile-time-init-build
      revision: v1.7.0
      path: modules/lib/cib
      groups:
        - firmware

    - name: openamp
      remote: github
      repo-path: OpenAMP/open-amp
      revision: v2024.10.0
      path: modules/lib/openamp
      groups:
        - firmware

  self:
    path: deepspan
```
