## CMakeLists.txt
```
# Zephyr app build configuration
# Build: west build -b native_sim/native/64 firmware/app
cmake_minimum_required(VERSION 3.27)

find_package(Zephyr REQUIRED HINTS $ENV{ZEPHYR_BASE})
project(DeepspanFirmware VERSION 0.1.0 LANGUAGES C CXX)

target_sources(app PRIVATE
    src/main.cpp
)

target_include_directories(app PRIVATE
    ${CMAKE_CURRENT_SOURCE_DIR}/../lib/transport/include
    ${CMAKE_CURRENT_SOURCE_DIR}/../lib/components
    ${WEST_TOPDIR}/modules/lib/etl/include
)

if(CONFIG_DEEPSPAN_USE_CIB)
  target_include_directories(app PRIVATE ${WEST_TOPDIR}/modules/lib/cib/include)
endif()
```

## prj.conf
```kconfig
# deepspan firmware default configuration
CONFIG_DEEPSPAN_FIRMWARE=y
CONFIG_DEEPSPAN_USE_ETL=y
CONFIG_DEEPSPAN_USE_CIB=y

# Zephyr default configuration
CONFIG_MAIN_STACK_SIZE=4096
CONFIG_SYSTEM_WORKQUEUE_STACK_SIZE=2048
CONFIG_LOG=y
CONFIG_LOG_DEFAULT_LEVEL=3
CONFIG_PRINTK=y

# C++ configuration — CIB requires C++20
CONFIG_CPP=y
CONFIG_STD_CPP20=y
CONFIG_REQUIRES_FULL_LIBCPP=y

# virtio/RPMsg (enable on real HW)
# CONFIG_DEEPSPAN_TRANSPORT_VIRTIO=y
# CONFIG_VIRTIO=y
# CONFIG_RPMSG=y
# CONFIG_OPENAMP=y
```

## boards/native_sim.conf
```kconfig
# native_sim target-specific configuration (simulation)
CONFIG_DEEPSPAN_TRANSPORT_SIM=y
CONFIG_DEEPSPAN_TRANSPORT_VIRTIO=n

# HWIP sim driver: connects to hw-model via POSIX shm
CONFIG_DEEPSPAN_HWIP_DRIVER_SIM=y
CONFIG_DEEPSPAN_HWIP_SIM_SHM_NAME="deepspan-sim"

# Disable CIB on native_sim — it requires a full hosted C++ stdlib
# (std::uint64_t in string_constant.hpp) not available in Zephyr freestanding mode
# CONFIG_DEEPSPAN_USE_CIB is not set

# native_sim only
CONFIG_NATIVE_APPLICATION=y
CONFIG_POSIX_API=y

# Verbose log level
CONFIG_LOG_DEFAULT_LEVEL=4
CONFIG_TEST_LOGGING=y
```

## src/main.cpp
```c
/**
 * @file main.cpp
 * @brief Deepspan firmware entry point
 *
 * Components are connected at compile time via the CIB nexus.
 * Services start zero-cost with no runtime registration.
 */

#include <zephyr/kernel.h>
#include <zephyr/logging/log.h>
#include <zephyr/version.h>

#if CONFIG_DEEPSPAN_TRANSPORT_VIRTIO
#include "deepspan/transport/virtio_transport.hpp"
#endif

#if CONFIG_DEEPSPAN_HWIP_DRIVER_SIM
#include "deepspan_hwip.h"

/* Generated opcode constants for the CRC32 HWIP */
#define CRC32_OP_COMPUTE  0x01U   /* dma_bytes: compute CRC32(data) → checksum */
#define CRC32_OP_GET_POLY 0x02U   /* fixed_args: return polynomial 0xEDB88320  */
#endif

LOG_MODULE_REGISTER(deepspan_main, CONFIG_DEEPSPAN_LOG_LEVEL);

int main(void)
{
    LOG_INF("Deepspan firmware starting (Zephyr %s)", KERNEL_VERSION_STRING);

#if CONFIG_DEEPSPAN_TRANSPORT_VIRTIO
    /* TODO: CIB nexus initialization (automatic component wiring)
     * cib::nexus<AppConfig>::init(); */

    static deepspan::transport::DefaultTransport g_transport;
    /* TODO: g_transport.init(SHM_BASE, SHM_SIZE); */

    LOG_INF("Deepspan firmware ready (VirtIO transport)");

    while (true) {
        g_transport.poll();
        k_sleep(K_MSEC(1));
    }

#elif CONFIG_DEEPSPAN_HWIP_DRIVER_SIM
    LOG_INF("Deepspan CRC32 firmware ready (HWIP sim driver)");

    const struct device *hwip = deepspan_hwip_sim_device();

    if (!device_is_ready(hwip)) {
        LOG_ERR("HWIP sim device not ready — is hw-model running?");
        return -1;
    }

    LOG_INF("HWIP hw_version=0x%08x", deepspan_hwip_version(hwip));

    /* ── Test 1: GET_POLY — verify polynomial via fixed_args opcode ─────── */
    {
        uint32_t result_status = 0u;
        uint32_t poly = 0u;
        uint32_t unused = 0u;

        int ret = deepspan_hwip_submit_cmd(
            hwip,
            CRC32_OP_GET_POLY,
            /*arg0=*/0u, /*arg1=*/0u,
            /*timeout_ms=*/3000u,
            &result_status, &poly, &unused
        );

        if (ret == 0) {
            LOG_INF("GET_POLY ok  polynomial=0x%08x  (expected 0xEDB88320)",
                    poly);
            if (poly != 0xEDB88320u) {
                LOG_ERR("Polynomial mismatch — hw-model may not be a CRC32 type");
            }
        } else {
            LOG_ERR("GET_POLY failed: %d", ret);
        }
    }

    /* ── Test 2: COMPUTE — CRC32 of a known string via dma_bytes opcode ─── */
    {
        /* Standard CRC32 test vector: CRC32("123456789") == 0xCBF43926 */
        static const char test_data[] = "123456789";
        const uint32_t test_len = sizeof(test_data) - 1u; /* exclude NUL */

        int dma_ret = deepspan_hwip_set_dma(hwip, test_data, test_len);
        if (dma_ret != 0) {
            LOG_ERR("set_dma failed: %d", dma_ret);
        } else {
            uint32_t result_status = 0u;
            uint32_t checksum = 0u;
            uint32_t unused = 0u;

            int ret = deepspan_hwip_submit_cmd(
                hwip,
                CRC32_OP_COMPUTE,
                /*arg0=*/test_len, /*arg1=*/0u,
                /*timeout_ms=*/3000u,
                &result_status, &checksum, &unused
            );

            if (ret == 0) {
                LOG_INF("COMPUTE ok  CRC32(\"123456789\")=0x%08x"
                        "  (expected 0xCBF43926)  %s",
                        checksum,
                        (checksum == 0xCBF43926u) ? "PASS" : "FAIL");
            } else {
                LOG_ERR("COMPUTE failed: %d", ret);
            }
        }
    }

    /* ── Periodic loop: recompute CRC32 of a rolling message ────────────── */
    {
        static const char loop_data[] = "Hello, deepspan CRC32!";
        const uint32_t loop_len = sizeof(loop_data) - 1u;
        uint32_t seq = 0u;

        while (true) {
            int dma_ret = deepspan_hwip_set_dma(hwip, loop_data, loop_len);
            if (dma_ret == 0) {
                uint32_t result_status = 0u;
                uint32_t checksum = 0u;
                uint32_t unused = 0u;

                int ret = deepspan_hwip_submit_cmd(
                    hwip,
                    CRC32_OP_COMPUTE,
                    loop_len, 0u,
                    3000u,
                    &result_status, &checksum, &unused
                );

                if (ret == 0) {
                    LOG_INF("CRC32 #%u: 0x%08x", seq, checksum);
                } else {
                    LOG_WRN("CRC32 #%u: submit failed %d", seq, ret);
                }
            } else {
                LOG_WRN("CRC32 #%u: set_dma failed %d", seq, dma_ret);
            }

            seq++;
            k_sleep(K_MSEC(2000));
        }
    }

#else
    LOG_INF("Deepspan firmware ready (simulation mode — no transport)");

    while (true) {
        k_sleep(K_MSEC(100));
    }
#endif

    return 0;
}
```
